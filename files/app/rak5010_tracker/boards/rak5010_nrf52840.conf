## files/app/rak5010_tracker/boards/rak5010_nrf52840.conf
```kconfig
CONFIG_UART_ASYNC_API=y
CONFIG_MODEM_CELLULAR_APN="iot.1nce.net"

# USB
CONFIG_USB_DEVICE_STACK_NEXT=y
CONFIG_USBD_CDC_ACM_CLASS=y
CONFIG_CDC_ACM_SERIAL_PID=0x0004
CONFIG_CDC_ACM_SERIAL_PRODUCT_STRING="RAK5010 Zephyr"
CONFIG_CDC_ACM_SERIAL_INITIALIZE_AT_BOOT=y

CONFIG_UART_CONSOLE=y
CONFIG_UART_LINE_CTRL=y
CONFIG_LOG_BACKEND_UART=y
CONFIG_LOG_BACKEND_RTT=n
CONFIG_USBD_LOG_LEVEL_OFF=y
CONFIG_USBD_CDC_ACM_LOG_LEVEL_OFF=y
CONFIG_UDC_DRIVER_LOG_LEVEL_OFF=y

# Networking
CONFIG_NETWORKING=y
CONFIG_NET_NATIVE=y
CONFIG_NET_L2_PPP=y
CONFIG_NET_IPV4=y
CONFIG_NET_UDP=y
CONFIG_NET_SOCKETS=y
CONFIG_NET_CONTEXT_RCVTIMEO=y

# Modem driver
CONFIG_MODEM=y
CONFIG_MODEM_CELLULAR=y
CONFIG_MODEM_CMUX_WORK_BUFFER_SIZE=1024

# ADC for battery voltage
CONFIG_ADC=y

# Disable keepalive; the tracker still reconnects each cycle today.
CONFIG_GOLIOTH_COAP_KEEPALIVE_INTERVAL_S=0
CONFIG_GOLIOTH_COAP_CLIENT_RX_TIMEOUT_SEC=900
CONFIG_GOLIOTH_COAP_CLIENT_SKIP_INITIAL_EMPTY=y

# Periodic poll — must be LONGER than sleep to avoid CMUX traffic during PSM
CONFIG_MODEM_CELLULAR_PERIODIC_SCRIPT_MS=180000

# App-managed AT diagnostics via modem user pipe
CONFIG_MODEM_AT_SHELL=n
```

## files/app/rak5010_tracker/boards/rak5010_nrf52840_debugcycle.conf
```kconfig
CONFIG_APP_DEBUG_MANUAL_CYCLE_MODE=y
CONFIG_GOLIOTH_USE_CONNECTION_ID=y
CONFIG_MBEDTLS_SSL_DTLS_CONNECTION_ID=y
CONFIG_GOLIOTH_COAP_CLIENT_RX_TIMEOUT_SEC=14400
CONFIG_APP_GOLIOTH_STREAM_ENABLE=y
CONFIG_APP_GOLIOTH_STREAM_PATH="/tracker"
CONFIG_SHELL_BACKEND_DUMMY=y
CONFIG_SHELL_BACKEND_DUMMY_BUF_SIZE=4096
```

## files/app/rak5010_tracker/boards/rak5010_nrf52840_offload.conf
```kconfig
CONFIG_NET_L2_PPP=n
CONFIG_MODEM_CELLULAR=n
CONFIG_MODEM_CELLULAR_APN=""

CONFIG_NET_SOCKETS_OFFLOAD=y
CONFIG_DNS_RESOLVER=y
CONFIG_DNS_RESOLVER_AUTO_INIT=n
CONFIG_DNS_SERVER_IP_ADDRESSES=n

CONFIG_MODEM=y
CONFIG_MODEM_QUECTEL_BG9X=y
CONFIG_PWM=y
CONFIG_MODEM_QUECTEL_BG9X_APN="iot.1nce.net"
CONFIG_MODEM_QUECTEL_BG9X_PSM_TAU="00000001"
CONFIG_MODEM_QUECTEL_BG9X_PSM_ACTIVE_TIME="00000001"
CONFIG_MODEM_SIM_NUMBERS=y
CONFIG_MODEM_CMD_HANDLER_MAX_PARAM_COUNT=20

CONFIG_NET_SOCKETS_SOCKOPT_TLS=y
CONFIG_NET_SOCKETS_ENABLE_DTLS=y
CONFIG_GOLIOTH_AUTH_PSK_MBEDTLS_DEPS=y
CONFIG_GOLIOTH_LIGHTDB_STATE=y
CONFIG_GOLIOTH_COAP_REQUEST_QUEUE_MAX_ITEMS=20
CONFIG_GOLIOTH_SETTINGS=y
CONFIG_GOLIOTH_STREAM=y
CONFIG_GOLIOTH_COAP_CLIENT_SKIP_INITIAL_EMPTY=y
CONFIG_ZVFS_EVENTFD_MAX=32
CONFIG_ZVFS_OPEN_MAX=64
CONFIG_WATCHDOG=y
CONFIG_HWINFO=y
CONFIG_FLASH_MAP=y
CONFIG_NVS=y
CONFIG_MPU_ALLOW_FLASH_WRITE=y

CONFIG_SENSOR=y
CONFIG_LIS2DH=y
CONFIG_LIS2DH_TRIGGER_NONE=n
CONFIG_LIS2DH_TRIGGER_GLOBAL_THREAD=y
CONFIG_LIS2DH_ACCEL_HP_FILTERS=y
CONFIG_LPS22HB=y
CONFIG_OPT3001=y
CONFIG_SHTCX=y

CONFIG_LOG_BACKEND_GOLIOTH=n
CONFIG_MODEM_LOG_LEVEL_INF=y

CONFIG_APP_SLEEP_SECONDS=300
CONFIG_APP_CONNECT_TIMEOUT_SECONDS=90
CONFIG_APP_WDT_TIMEOUT_SECONDS=360
# CONFIG_APP_PSM_DISABLED_DEFAULT is not set
CONFIG_APP_GPS_ENABLED_DEFAULT=y
CONFIG_APP_TRACKER_START_PARKED=n
CONFIG_APP_PARKED_HEARTBEAT_SECONDS=1800
CONFIG_APP_MOTION_THRESHOLD_MG=500
CONFIG_APP_MOTION_DURATION_SAMPLES=20
CONFIG_APP_TRACKING_SPEED_THRESHOLD_KMH=16
CONFIG_APP_TRACKING_STOP_COUNT=2
CONFIG_APP_GOLIOTH_STREAM_ENABLE=y
CONFIG_APP_GOLIOTH_STREAM_COMPACT_CBOR=y
CONFIG_APP_CBOR_ENABLED_DEFAULT=y
CONFIG_APP_MINIFIED_PAYLOAD_DEFAULT=y
CONFIG_APP_XTRA_ENABLED_DEFAULT=n
CONFIG_APP_XTRA_RETENTION_DEFAULT=3
CONFIG_APP_XTRA_MODE_DEFAULT=0
CONFIG_APP_LOG_RAW_TRACKER_PAYLOAD=y
```
